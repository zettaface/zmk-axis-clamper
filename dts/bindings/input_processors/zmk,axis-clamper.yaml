## dts/bindings/input_processors/zmk,axis-clamper.yaml
```yaml
description: Input Processor for clamping movements to a single axis
compatible: "zmk,axis-clamper"
include: ip_zero_param.yaml

properties:
  history-size:
    type: int
    required: true
  hysteresis:
    type: int
    required: true
  threshold:
    type: int
    required: true
```

## src/pointing/Kconfig
```kconfig
if ZMK_POINTING

config ZMK_AXIS_CLAMPER
    bool "Axis clamper"
    default y
    depends on INPUT

config ZMK_AXIS_CLAMPER_HISTORY_TTL
    int "History TTL, msec"
    default 1250

endif # ZMK_POINTING
```
